## u-boot-2016.03-rc2/board/hp/marlin/Kconfig
```kconfig
if TARGET_MARLIN

config SYS_BOARD
	default "marlin"

config SYS_VENDOR
	default "hp"

config SYS_SOC
	default "marlin"

config SYS_CONFIG_NAME
	default "marlin"

endif
```
